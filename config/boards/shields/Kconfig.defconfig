## config/boards/shields/Kconfig.defconfig
```kconfig
if SHIELD_SCRIPTURAM_LEFT

config ZMK_SCRIPTURAM
    default "Scripturam"

config ZMK_SPLIT_ROLE_CENTRAL
    default y

endif

if SHIELD_SCRIPTURAM_LEFT || SHIELD_SCRIPTURAM_RIGHT

config ZMK_SPLIT
    default y

endif
```

## config/boards/shields/Kconfig.shield
```kconfig
config SHIELD_SCRIPTURAM_LEFT
    def_bool $(shields_list_contains, scripturam_left)

config SHIELD_SCRIPTURAM_RIGHT
    def_bool $(shields_list_contains, scripturam_right)
```
